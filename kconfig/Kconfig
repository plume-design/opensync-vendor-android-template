## kconfig/Kconfig
```kconfig
if VENDOR_IS_ANDROID
    menu "Android Options"
        config LIBC_BIONIC
            bool "Libc is Android Bionic"
            default y

        config APK_INSTALL_PATH
            string "OpenSync Android Package Install Directory"
            default "/data/data/com.opensync.app/"

        config ANDROID_ZMQ_REQREP_SOCK_ADDR
            string "OpenSync APP IPC Socket"
            default "tcp://127.0.0.1:10086"

        config ANDROID_ZMQ_PUBSUB_SOCK_ADDR
            string "OpenSync APP IPC Socket"
            default "tcp://127.0.0.1:10087"

        config ANDROID_ZMQ_SOCKET_MAX_RETRY_TIMES
            int "Threshold of ZMQ retry send times"
            default 10
            help
                Threshold of ZMQ retry send times

        config ANDROID_ZMQ_SOCKET_MAX_BACKOFF_TIME
            int "Threshold of ZMQ backoff send time(ms)"
            default 200
            help
                Threshold of ZMQ backoff send time(ms)

        config ANDROID_OPENSYNC_BLE_ENABLED
            bool "Enable BLEM on Android"
            default n
    endmenu
endif
```

## kconfig/Kconfig.osp_ble.backend
```kconfig
config OSP_BLE_ANDROID
    bool "Android Standard BLE"
    depends on ANDROID_OPENSYNC_BLE_ENABLED
    help
        This option enables override of osp_ble functions
```

## kconfig/Kconfig.vendor
```kconfig
menuconfig VENDOR_IS_ANDROID
    bool "Android"
    help
        OpenSync vendor layer for Android devices.
```

## src/lib/osp/kconfig/Kconfig.osp_ble.backend
```kconfig
config OSP_BLE_ANDROID
    bool "Android Standard BLE"
    help
        This option enables support for override ble osp function on Android
```

## src/lib/osp/kconfig/Kconfig.osp_unit.backend
```kconfig
config OSP_UNIT_ANDROID
    bool "Using Android OSP API"
    help
        OSP unit API implementation used for Android platform.

if OSP_UNIT_ANDROID
    config OSP_UNIT_ANDROID_SERIAL_PREFIX
        string "Unit serial number prefix"
        default "OSx"
endif
```
